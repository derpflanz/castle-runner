; This file shows all features of the parser.

; Mark the origin of the hex file. The first generated byte is assumed to be
; on this address.
.orig $8000

; Add a verbatim byte; when placed at the top, they can be addressed from
; .orig onwards as a sort of simple array
.byte $10
.byte 'A'

; An array can be defined with hex numbers or ASCII characters
array = [ $12, $34, 'A', 'z' ]

; Create a variable with a name. Can be used as (zeropage) address or number
value = $bf
zeropage = $99
absolute = $8012

; Mnemonic with all supported addressing modes
LDA #$00            ; Immediate
LDA $00             ; Zero page
LDA $00,X           ; Zero page with X
LDA $2000           ; Absolute
LDA $2000,X         ; Absolute with X
LDA $2000,Y         ; Absolute with Y
LDA ($00,X)         ; Indexed Indirect
LDA ($00),Y         ; Indirect Indexed
LDX $00,Y           ; Zero page with Y
JMP ($2000)         ; Indirect (only supported for JMP)

; Nmemonic with variables in all addressing modes
LDA #value          ; Immediate
LDA zeropage        ; Zero page
LDA zeropage,X      ; Zero page with X
LDA absolute        ; Absolute
LDA absolute,X      ; Absolute with X
LDA absolute,Y      ; Absolute with Y
LDA (zeropage,X)    ; Indexed Indirect
LDA (zeropage),Y    ; Indirect Indexed
LDX zeropage,Y      ; Zero page with Y
JMP (absolute)      ; Indirect

; Take higher / lower order byte, to place 16-bit pointers into memory
STA >$1234          ; Higher order byte ($12)
STA <$1234          ; Lower order byte ($34)
STA >absolute
STA <absolute

; Do basic arithmetic with variables
LDA zeropage+1
LDA zeropage-1

; Jump / branch to a label
label:
JMP label           ; Jumps to absolute address
BNE label           ; Jumps to relative address

; Register hardware interrupt (when run with -a option)
HW_IRQ:
RTS

